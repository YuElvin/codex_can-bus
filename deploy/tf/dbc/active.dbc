BO_ 801 Can2Data: 8 Vector__XXX
 SG_ marker : 0|16@1+ (1,0) [0|65535] "count" Vector__XXX
 SG_ sequence : 16|16@1+ (1,0) [0|65535] "count" Vector__XXX
